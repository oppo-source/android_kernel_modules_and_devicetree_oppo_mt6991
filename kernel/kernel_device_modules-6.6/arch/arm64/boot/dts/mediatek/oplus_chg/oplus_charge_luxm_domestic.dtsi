// SPDX-License-Identifier: GPL-2.0-only
/*
* Copyright (C) 2025 Oplus. All rights reserved.
*/
#include "oplus_charge_luxm_common.dtsi"

&oplus_cpa {
	oplus,protocol_list = <CHG_PROTOCOL_UFCS 80
			       CHG_PROTOCOL_VOOC 80
			       CHG_PROTOCOL_PPS 55
			       CHG_PROTOCOL_PD 18
			       CHG_PROTOCOL_QC 18>;
	oplus,default_protocol_list = <CHG_PROTOCOL_UFCS
				       CHG_PROTOCOL_VOOC
				       CHG_PROTOCOL_PPS
				       CHG_PROTOCOL_PD>;
};
