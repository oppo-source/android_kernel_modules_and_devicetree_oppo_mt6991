// SPDX-License-Identifier: GPL-2.0-only
/*
* Copyright (C) 2021-2020 Oplus. All rights reserved.
*/
#include <dt-bindings/iio/mt635x-auxadc.h>
#include <dt-bindings/pinctrl/mt6991-pinfunc.h>
#include <dt-bindings/pinctrl/mt65xx.h>

&peak_power_budget {
	compatible = "mediatek,peak_power_budget";
	bootmode = <&chosen>;
	gauge = <&mtk_gauge>;
	reg = <0 0x00117700 0 0x100>,
		<0 0x13020170 0 0xc>,
		<0 0x4b840c18 0 0x8>,
		<0 0x0c220c04 0 0x20>;
	reg-names = "ppb_sram",
		"hpt_ctrl","gpu_dbg", "cpu_dbg";

	ppb-version = <2>;
	soc-error = <500>;
	battery-circult-rdc  = <31>;
	battery0-path-rac-t0 = <51>;
	battery0-path-rac-t1 = <51>;
	battery0-path-rac-t2 = <51>;
	battery0-path-rac-t3 = <51>;
	battery1-path-rac-t0 = <51>;
	battery1-path-rac-t1 = <51>;
	battery1-path-rac-t2 = <51>;
	battery1-path-rac-t3 = <51>;
	battery2-path-rac-t0 = <51>;
	battery2-path-rac-t1 = <51>;
	battery2-path-rac-t2 = <51>;
	battery2-path-rac-t3 = <51>;
	temperature-threshold = <25 10 0>;
	system-ocp = <15000>;
	system-uvlo = <2200>;

	soc-max-level = <3>;     //+lv3
	soc-hpt-ctrl-lv1 = <7>;  //lv1 pre-uv on
	soc-hpt-ctrl-lv2 = <0>;  //lv2 pre-uv off
	soc-hpt-ctrl-lv3 = <0>;  //lv3 pre-uv off

	//hpt-volt = 0(2.4V), 1(2.6V) 2(2.8V) 3(3.0V) 4(3.2V)
	soc-hpt-volt-lv0 = <0>; //lv0 is high battery level setting
	soc-hpt-volt-lv1 = <0>;
	soc-hpt-volt-lv2 = <0>;
	soc-hpt-volt-lv3 = <0>;

	bat-ocv-table-num = <6>;
	bat0-ocv-table-t0-temperature = <50>;
		bat0-ocv-table-t0-qmax = <7570>;
	bat0-ocv-table-t0-size = <100>;
	bat0-ocv-table-t0 = <
		0		44475	0		512
		765		44356	101		519
		1529	44252	202		520
		2294	44157	303		516
		3059	44063	404		521
		3824	43970	505		534
		4588	43875	606		555
		5353	43773	707		542
		6118	43671	808		549
		6883	43569	909		541
		7647	43459	1010	536
		8412	43346	1111	524
		9177	43240	1212	550
		9942	43128	1313	560
		10706	43008	1414	537
		11471	42893	1515	554
		12236	42771	1616	560
		13001	42656	1717	571
		13765	42535	1818	570
		14530	42412	1919	585
		15295	42285	2020	576
		16060	42159	2121	588
		16824	42032	2222	612
		17589	41905	2323	642
		18354	41757	2424	646
		19119	41549	2525	592
		19883	41328	2626	545
		20648	41168	2727	550
		21413	41034	2828	538
		22177	40911	2929	538
		22942	40798	3030	541
		23707	40685	3131	542
		24472	40567	3232	528
		25236	40460	3333	542
		26001	40357	3434	558
		26766	40255	3535	563
		27531	40150	3636	559
		28295	40046	3737	553
		29060	39951	3838	575
		29825	39854	3939	580
		30590	39750	4040	580
		31354	39648	4141	600
		32119	39488	4242	538
		32884	39321	4343	541
		33649	39180	4445	548
		34413	39049	4545	550
		35178	38916	4646	543
		35943	38798	4748	551
		36708	38681	4849	554
		37472	38564	4949	561
		38237	38439	5051	586
		39002	38294	5152	575
		39767	38163	5253	588
		40531	38033	5354	599
		41296	37906	5455	625
		42061	37803	5556	594
		42826	37724	5657	584
		43590	37657	5758	595
		44355	37575	5859	586
		45120	37481	5960	618
		45884	37350	6061	753
		46649	37215	6162	858
		47414	37098	6263	904
		48179	36976	6364	916
		48943	36846	6465	931
		49708	36718	6566	952
		50473	36579	6667	962
		51238	36443	6768	991
		52002	36293	6869	983
		52767	36142	6970	1021
		53532	35989	7071	1000
		54297	35832	7172	983
		55061	35677	7273	966
		55826	35522	7374	949
		56591	35376	7475	932
		57356	35229	7576	915
		58120	35080	7677	900
		58885	34926	7778	893
		59650	34776	7879	886
		60415	34617	7980	879
		61179	34451	8081	872
		61944	34281	8182	865
		62709	34096	8283	850
		63474	33903	8384	816
		64238	33702	8485	782
		65003	33492	8586	748
		65768	33282	8687	714
		66532	33069	8788	680
		67297	32855	8889	642
		68062	32645	8990	604
		68827	32421	9091	566
		69591	32185	9192	530
		70356	31907	9293	488
		71121	31575	9394	446
		71886	31135	9495	400
		72650	30555	9596	250
		73415	29829	9697	100
		74180	28991	9798	100
		74945	28061	9899	100
		75709	27005	10000	100
					>;

	bat0-ocv-table-t1-temperature = <25>;
	bat0-ocv-table-t1-qmax = <7641>;
	bat0-ocv-table-t1-size = <100>;
	bat0-ocv-table-t1 = <
		0		44556	0		793
		772		44411	101		793
		1544	44296	202		795
		2316	44215	303		834
		3088	44133	404		820
		3859	44033	505		795
		4631	43936	606		798
		5403	43816	707		786
		6175	43732	808		791
		6947	43643	909		812
		7719	43535	1010	805
		8491	43425	1111	801
		9263	43317	1212	789
		10035	43204	1313	806
		10807	43090	1414	805
		11578	42970	1515	806
		12350	42857	1616	832
		13122	42731	1717	820
		13894	42611	1818	836
		14666	42488	1919	856
		15438	42363	2020	861
		16210	42237	2121	868
		16982	42112	2222	890
		17754	41983	2323	903
		18525	41855	2424	914
		19297	41717	2525	933
		20069	41562	2626	944
		20841	41347	2727	875
		21613	41111	2828	788
		22385	40956	2929	788
		23157	40819	3030	747
		23929	40703	3131	771
		24701	40585	3232	763
		25473	40475	3333	769
		26244	40361	3434	768
		27016	40257	3535	758
		27788	40152	3636	774
		28560	40051	3737	774
		29332	39951	3838	775
		30104	39850	3939	785
		30876	39759	4040	789
		31648	39659	4141	804
		32420	39563	4242	805
		33192	39473	4343	819
		33963	39354	4444	791
		34735	39219	4545	762
		35507	39092	4646	757
		36279	38960	4747	759
		37051	38839	4848	759
		37823	38716	4949	759
		38595	38600	5051	759
		39367	38476	5152	774
		40139	38332	5253	779
		40910	38195	5353	774
		41682	38051	5454	793
		42454	37913	5555	804
		43226	37790	5657	791
		43998	37706	5758	776
		44770	37635	5859	778
		45542	37562	5960	791
		46314	37474	6061	806
		47086	37333	6162	957
		47858	37194	6263	1124
		48629	37067	6364	1146
		49401	36936	6465	1132
		50173	36807	6566	1118
		50945	36673	6667	1104
		51717	36531	6768	1090
		52489	36405	6869	1076
		53261	36255	6970	1062
		54033	36098	7071	1050
		54805	35943	7172	1042
		55576	35782	7273	1034
		56348	35620	7374	1026
		57120	35465	7475	1018
		57892	35315	7576	1010
		58664	35166	7677	1002
		59436	35013	7778	1000
		60208	34858	7879	970
		60980	34697	7980	940
		61752	34532	8081	910
		62524	34361	8182	880
		63295	34173	8283	850
		64067	33975	8384	820
		64839	33759	8485	790
		65611	33550	8586	760
		66383	33323	8687	730
		67155	33106	8788	700
		67927	32881	8889	640
		68699	32654	8990	580
		69471	32426	9091	520
		70242	32192	9192	450
		71014	31920	9293	400
		71786	31590	9394	350
		72558	31167	9495	300
		73330	30608	9596	100
		74102	29902	9697	100
		74874	29066	9798	100
		75646	28124	9899	100
		76418	27070	10000	100
		>;

	bat0-ocv-table-t2-temperature = <10>;
	bat0-ocv-table-t2-qmax = <7595>;
	bat0-ocv-table-t2-size = <100>;
	bat0-ocv-table-t2 = <
		0		44618	0		1312
		767		44474	101		1324
		1534	44371	202		1319
		2302	44278	303		1305
		3069	44190	404		1313
		3836	44103	505		1307
		4603	44011	606		1296
		5371	43919	707		1307
		6138	43823	808		1296
		6905	43726	909		1297
		7672	43622	1010	1290
		8440	43520	1111	1287
		9207	43416	1212	1310
		9974	43306	1313	1319
		10741	43195	1414	1325
		11509	43080	1515	1335
		12276	42964	1616	1339
		13043	42846	1717	1360
		13810	42721	1818	1352
		14578	42600	1919	1369
		15345	42474	2020	1383
		16112	42347	2121	1392
		16879	42221	2222	1418
		17647	42093	2323	1427
		18414	41959	2424	1444
		19181	41819	2525	1459
		19948	41665	2626	1442
		20716	41474	2727	1396
		21483	41253	2828	1295
		22250	41060	2929	1237
		23017	40909	3030	1230
		23785	40782	3131	1226
		24552	40657	3232	1216
		25319	40540	3333	1207
		26086	40430	3434	1201
		26854	40320	3535	1209
		27621	40215	3636	1201
		28388	40109	3737	1203
		29155	40008	3838	1208
		29923	39910	3939	1208
		30690	39810	4040	1227
		31457	39713	4141	1219
		32224	39618	4242	1214
		32992	39523	4343	1229
		33759	39428	4444	1222
		34526	39328	4545	1221
		35293	39225	4646	1219
		36061	39107	4747	1184
		36828	38973	4848	1171
		37595	38845	4949	1155
		38362	38726	5050	1164
		39130	38605	5152	1164
		39897	38470	5253	1163
		40664	38323	5353	1171
		41431	38188	5454	1163
		42199	38050	5556	1179
		42966	37908	5657	1185
		43733	37797	5758	1171
		44500	37716	5859	1180
		45268	37639	5960	1185
		46035	37564	6061	1207
		46802	37463	6162	1233
		47569	37299	6263	1340
		48337	37147	6364	1320
		49104	37012	6465	1300
		49871	36878	6566	1287
		50638	36746	6667	1274
		51406	36611	6768	1261
		52173	36469	6869	1248
		52940	36327	6970	1235
		53707	36175	7071	1222
		54475	36018	7172	1200
		55242	35859	7273	1170
		56009	35692	7374	1140
		56776	35532	7475	1110
		57544	35368	7576	1080
		58311	35208	7677	1050
		59078	35053	7778	1020
		59845	34893	7879	992
		60613	34737	7980	964
		61380	34571	8081	936
		62147	34392	8182	908
		62914	34213	8283	880
		63682	34016	8384	850
		64449	33812	8485	810
		65216	33596	8586	770
		65983	33367	8687	730
		66751	33145	8788	700
		67518	32915	8889	660
		68285	32688	8990	620
		69052	32469	9091	580
		69820	32235	9192	550
		70587	31993	9293	480
		71354	31708	9394	410
		72121	31362	9495	350
		72889	30919	9596	100
		73656	30333	9697	100
		74423	29609	9798	100
		75190	28749	9899	100
		75958	27787	10000	100
		>;
	bat0-ocv-table-t3-temperature = <0>;
	bat0-ocv-table-t3-qmax = <7068>;
	bat0-ocv-table-t3-size = <100>;
	bat0-ocv-table-t3 = <
		0		44168	0		1900
		714		44039	101		1930
		1428	43930	202		1958
		2142	43832	303		1973
		2856	43733	404		1995
		3570	43636	505		1999
		4284	43533	606		2020
		4998	43435	707		2034
		5712	43330	808		2041
		6426	43228	909		2078
		7140	43117	1010	1940
		7854	43011	1111	1970
		8568	42899	1212	1991
		9282	42784	1313	2039
		9996	42671	1414	2084
		10710	42552	1515	2056
		11424	42435	1616	2079
		12138	42319	1717	2095
		12852	42200	1818	2126
		13566	42083	1919	2144
		14280	41959	2020	2152
		14994	41838	2121	2155
		15708	41706	2222	2173
		16422	41558	2323	2190
		17136	41375	2424	2114
		17850	41171	2525	2009
		18564	40985	2626	1959
		19278	40833	2727	1947
		19992	40706	2828	1946
		20706	40591	2929	1965
		21420	40484	3030	1720
		22134	40378	3131	1811
		22848	40273	3232	1831
		23562	40174	3333	1928
		24276	40074	3434	1943
		24990	39979	3535	1930
		25704	39886	3636	1917
		26418	39794	3737	1904
		27132	39705	3838	1891
		27846	39619	3939	1878
		28560	39531	4040	1865
		29274	39447	4141	1852
		29988	39364	4242	1839
		30702	39275	4343	1826
		31416	39188	4445	1813
		32129	39094	4545	1800
		32843	38989	4646	1778
		33557	38876	4747	1756
		34271	38760	4848	1734
		34985	38646	4949	1712
		35699	38530	5050	1690
		36413	38401	5151	1668
		37127	38268	5252	1646
		37841	38140	5353	1624
		38555	38011	5454	1600
		39269	37877	5555	1578
		39983	37764	5657	1556
		40697	37686	5758	1534
		41411	37617	5859	1512
		42125	37548	5960	1490
		42839	37471	6061	1468
		43553	37349	6162	1446
		44267	37168	6263	1424
		44981	37027	6364	1400
		45695	36901	6465	1379
		46409	36771	6566	1358
		47123	36647	6667	1337
		47837	36518	6768	1316
		48551	36381	6869	1295
		49265	36244	6970	1274
		49979	36100	7071	1250
		50693	35955	7172	1221
		51407	35806	7273	1192
		52121	35649	7374	1163
		52835	35521	7475	1134
		53549	35343	7576	1105
		54263	35186	7677	1076
		54977	35038	7778	1050
		55691	34891	7879	1020
		56405	34740	7980	990
		57119	34588	8081	960
		57833	34425	8182	930
		58547	34248	8283	900
		59261	34060	8384	870
		59975	33861	8485	835
		60689	33654	8586	800
		61403	33435	8687	765
		62117	33215	8788	730
		62831	33001	8889	700
		63545	32791	8990	675
		64259	32577	9091	650
		64973	32359	9192	625
		65687	32141	9293	600
		66401	31903	9394	567
		67115	31635	9495	534
		67829	31308	9596	500
		68543	30903	9697	450
		69257	30398	9798	400
		69971	29756	9899	350
		70685	28955	10000	300
		>;

	bat0-ocv-table-t4-temperature = <(-10)>;
	bat0-ocv-table-t4-qmax = <6989>;
	bat0-ocv-table-t4-size = <100>;
	bat0-ocv-table-t4 = <
		0		44630	0		3849
		706		44473	101		3859
		1412	44357	202		3833
		2118	44261	303		3853
		2824	44178	404		3881
		3530	44090	505		3926
		4236	44006	606		3958
		4942	43915	707		3948
		5648	43826	808		3931
		6354	43738	909		3931
		7060	43645	1010	3925
		7766	43549	1111	3931
		8472	43453	1212	3936
		9178	43360	1313	3966
		9884	43250	1414	4042
		10590	43143	1515	4103
		11296	43035	1616	4134
		12002	42929	1717	4092
		12708	42815	1818	4050
		13414	42699	1919	4008
		14120	42577	2020	3966
		14826	42463	2121	3924
		15532	42331	2222	3882
		16238	42204	2323	3840
		16944	42072	2424	3800
		17650	41929	2525	3750
		18356	41781	2626	3700
		19062	41627	2727	3650
		19768	41461	2828	3600
		20474	41297	2929	3550
		21180	41146	3030	3500
		21887	40999	3131	3467
		22593	40861	3232	3434
		23299	40736	3333	3401
		24005	40619	3434	3368
		24711	40503	3535	3335
		25417	40399	3636	3302
		26123	40294	3737	3269
		26829	40188	3838	3236
		27535	40090	3939	3200
		28241	39991	4040	3182
		28947	39892	4141	3164
		29653	39799	4242	3146
		30359	39708	4343	3128
		31065	39614	4444	3110
		31771	39526	4545	3092
		32477	39431	4646	3074
		33183	39341	4747	3056
		33889	39256	4848	3038
		34595	39155	4949	3020
		35301	39067	5051	3000
		36007	38969	5152	2967
		36713	38868	5253	2934
		37419	38758	5354	2901
		38125	38648	5455	2868
		38831	38532	5556	2835
		39537	38404	5657	2802
		40243	38278	5758	2769
		40949	38153	5859	2736
		41655	38015	5960	2700
		42361	37879	6061	2669
		43067	37764	6162	2638
		43773	37688	6263	2607
		44479	37606	6364	2576
		45185	37528	6465	2545
		45891	37443	6566	2514
		46597	37329	6667	2483
		47303	37139	6768	2450
		48009	36936	6869	2543
		48715	36807	6970	2636
		49421	36671	7071	2729
		50127	36540	7172	2822
		50833	36413	7273	2915
		51539	36278	7374	3008
		52245	36131	7475	3100
		52951	35987	7576	3056
		53657	35837	7677	3012
		54363	35684	7778	2968
		55069	35522	7879	2924
		55775	35362	7980	2880
		56481	35195	8081	2836
		57187	35035	8182	2800
		57893	34868	8283	2740
		58599	34757	8384	2680
		59305	34508	8485	2620
		60011	34327	8586	2560
		60717	34136	8687	2500
		61423	33934	8788	2440
		62129	33725	8889	2380
		62835	33510	8990	2320
		63541	33294	9091	2260
		64247	33075	9192	2200
		64953	32863	9293	2140
		65660	32660	9394	2080
		66366	32451	9495	2020
		67072	32252	9596	1960
		67778	32036	9697	1900
		68484	31812	9798	1800
		69190	31603	9899	1700
		69896	31268	10000	1600
		>;

	bat0-ocv-table-t5-temperature = <(-20)>;
	bat0-ocv-table-t5-qmax = <6643>;
	bat0-ocv-table-t5-size = <100>;
	bat0-ocv-table-t5 = <
		0		44661	0		4000
		671		44432	101		4000
		1342	44284	202		4000
		2013	44160	303		4000
		2684	44055	404		4000
		3355	43949	505		4000
		4026	43846	606		4000
		4697	43750	707		4000
		5369	43651	808		4000
		6040	43558	909		4000
		6711	43462	1010	4000
		7382	43362	1111	4000
		8053	43265	1212	4000
		8724	43166	1313	4000
		9395	43069	1414	4000
		10066	42964	1515	4000
		10737	42858	1616	4000
		11408	42753	1717	4000
		12079	42643	1818	4000
		12750	42529	1919	4000
		13421	42418	2020	4000
		14092	42303	2121	4000
		14764	42184	2222	4000
		15435	42061	2323	4000
		16106	41936	2424	4000
		16777	41810	2525	4000
		17448	41678	2626	4000
		18119	41543	2727	4000
		18790	41406	2828	4000
		19461	41272	2929	4000
		20132	41140	3030	4000
		20803	41009	3131	4000
		21474	40884	3232	4000
		22145	40758	3333	4000
		22816	40641	3434	4000
		23487	40531	3535	4000
		24158	40420	3636	4000
		24830	40307	3737	4000
		25501	40207	3838	4000
		26172	40105	3939	4000
		26843	40006	4040	4000
		27514	39911	4141	4000
		28185	39819	4242	4000
		28856	39725	4343	4000
		29527	39637	4444	4000
		30198	39552	4545	4000
		30869	39460	4646	4000
		31540	39373	4747	4000
		32211	39285	4848	4000
		32882	39201	4949	4000
		33553	39110	5050	4000
		34225	39029	5152	4000
		34896	38949	5253	4000
		35567	38855	5354	4000
		36238	38772	5455	4000
		36909	38683	5556	4000
		37580	38586	5657	4000
		38251	38495	5758	4000
		38922	38389	5859	4000
		39593	38291	5960	4000
		40264	38182	6061	4000
		40935	38078	6162	4000
		41606	37964	6263	4000
		42277	37849	6364	4000
		42948	37740	6465	4000
		43619	37646	6566	4000
		44291	37561	6667	4000
		44962	37491	6768	4000
		45633	37418	6869	4000
		46304	37343	6970	4000
		46975	37250	7071	4000
		47646	37119	7172	4000
		48317	36943	7273	4000
		48988	36752	7374	4000
		49659	36603	7475	4000
		50330	36472	7576	4000
		51001	36351	7677	4000
		51672	36238	7778	4000
		52343	36109	7879	4000
		53014	35977	7980	4000
		53686	35842	8081	4000
		54357	35703	8182	4000
		55028	35557	8283	4000
		55699	35401	8384	4000
		56370	35238	8485	4000
		57041	35076	8586	4000
		57712	34908	8687	4000
		58383	34739	8788	4000
		59054	34566	8889	4000
		59725	34389	8990	4000
		60396	34204	9091	4000
		61067	34008	9192	4000
		61738	33802	9293	4000
		62409	33588	9394	4000
		63081	33365	9495	4000
		63752	33147	9596	4000
		64423	32937	9697	4000
		65094	32725	9798	4000
		65765	32527	9899	4000
		66436	32322	10000	4000
		>;
	};
