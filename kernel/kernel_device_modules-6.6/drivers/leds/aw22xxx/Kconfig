## kernel/kernel_device_modules-6.6/drivers/leds/aw22xxx/Kconfig
```kconfig
config LEDS_AW22XXX
	tristate "LED Support for AW22XXX"
	depends on LEDS_CLASS && I2C
	help
	  this option enables support for the AW22XXX LED connected
	  through I2C. Say Y to enable support for the AW22XXX LED
	  light automatically.
```

## vendor/oplus/kernel/cpu/Kconfig
```kconfig
# SPDX-License-Identifier: GPL-2.0-only
# Copyright (C) 2018-2022 Oplus. All rights reserved.

config OPLUS_FEATURE_GEAS
        tristate "geas"
        default n
        help
          turning for game

config OPLUS_FEATURE_GEAS_CPU
        tristate "geas cpu"
        depends on OPLUS_FEATURE_GEAS
        default n
        help
          turning for game

config OPLUS_FEATURE_GEAS_FDRIVE
        tristate "geas frame drive"
        depends on OPLUS_FEATURE_GEAS
        default n
        help
          turning for game

config OPLUS_FEATURE_GEAS_BWMON
        tristate "geas bwmon"
        depends on OPLUS_FEATURE_GEAS
        default n
        help
          turning for game

config OPLUS_FEATURE_GEAS_GPU
        tristate "geas gpu"
        depends on OPLUS_FEATURE_GEAS
        default n
        help
          turning for game

config OPLUS_FEATURE_GEAS_MEMLAT
        tristate "geas memlat"
        depends on OPLUS_FEATURE_GEAS
        default n
        help
          turning for game

config OPLUS_FEATURE_GEAS_EMI
        tristate "geas emi"
        depends on OPLUS_FEATURE_GEAS
        default n
        help
          turning for game

config OPLUS_FEATURE_GEAS_NPU
        tristate "geas emi"
        depends on OPLUS_FEATURE_GEAS
        default n
        help
          turning for game

config OPLUS_FEATURE_CPU
	bool "oplus cpu feature"
    default n
	help
	  Add for CPU Feature

source "$(KCONFIG_EXT_PREFIX)kernel/oplus_cpu/cpufreq_health/Kconfig"
source "$(KCONFIG_EXT_PREFIX)kernel/oplus_cpu/cpufreq_bouncing/Kconfig"
source "$(KCONFIG_EXT_PREFIX)kernel/oplus_cpu/sched/Kconfig"
source "$(KCONFIG_EXT_PREFIX)kernel/oplus_cpu/uad/Kconfig"
source "$(KCONFIG_EXT_PREFIX)kernel/oplus_cpu/oplus_slc/Kconfig"
source "$(KCONFIG_EXT_PREFIX)kernel/oplus_cpu/oplus_omrg/Kconfig"
source "$(KCONFIG_EXT_PREFIX)kernel/oplus_cpu/oplus_overload/Kconfig"
source "$(KCONFIG_EXT_PREFIX)kernel/oplus_cpu/waker_identify/Kconfig"
source "$(KCONFIG_EXT_PREFIX)kernel/oplus_cpu/oplus_game/Kconfig"
source "$(KCONFIG_EXT_PREFIX)kernel/oplus_cpu/close_loop/Kconfig"
source "$(KCONFIG_EXT_PREFIX)kernel/oplus_cpu/smart_freq/Kconfig"
source "$(KCONFIG_EXT_PREFIX)kernel/oplus_cpu/freq_tune_policy/Kconfig"
```
